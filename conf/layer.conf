## conf/layer.conf
```bitbake
# We have a conf and classes directory, add to BBPATH 
BBPATH := "${BBPATH}:${LAYERDIR}" 
# We have a packages directory, add to BBFILES 
BBFILES := "${BBFILES} ${LAYERDIR}/recipes-images/images/core-image-ridgerun.bb <RECIPES>" 
BBFILE_COLLECTIONS += "ridgerun" 
BBFILE_PATTERN_ridgerun := "^${LAYERDIR}/" 
BBFILE_PRIORITY_ridgerun := "5"
```
